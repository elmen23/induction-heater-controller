#include "web_server.h"
#include "mcpwm_control.h"
#include "wifi_manager.h"
#include "esp_log.h"
#include "esp_http_server.h"
#include "esp_timer.h"
#include "cJSON.h"
#include <cstring>

static const char *TAG = "HTTP";

static httpd_handle_t s_server = nullptr;

/* ════════════════════════════════════════════
 *  Embedded file helpers
 * ════════════════════════════════════════════ */

// These symbols are generated by ESP-IDF's EMBED_FILES directive.
// The names are: _binary_<filename>_start / _binary_<filename>_end
// where dots and slashes are replaced with underscores.
extern const uint8_t  index_html_start[]   asm("_binary_index_html_start");
extern const uint8_t  index_html_end[]     asm("_binary_index_html_end");
extern const uint8_t  style_css_start[]    asm("_binary_style_css_start");
extern const uint8_t  style_css_end[]      asm("_binary_style_css_end");
extern const uint8_t  script_js_start[]    asm("_binary_script_js_start");
extern const uint8_t  script_js_end[]      asm("_binary_script_js_end");

struct EmbeddedFile {
    const char *uri;
    const char *mime;
    const uint8_t *start;
    const uint8_t *end;
};

static const EmbeddedFile s_files[] = {
    { "/",          "text/html",                  index_html_start, index_html_end },
    { "/index.html","text/html; charset=utf-8",    index_html_start, index_html_end },
    { "/style.css", "text/css; charset=utf-8",     style_css_start,  style_css_end },
    { "/script.js", "application/javascript",      script_js_start,  script_js_end },
};

static esp_err_t serve_file(httpd_req_t *req, const EmbeddedFile &f) {
    size_t len = f.end - f.start;
    httpd_resp_set_type(req, f.mime);
    httpd_resp_set_hdr(req, "Cache-Control", "no-cache, no-store, must-revalidate");
    httpd_resp_send(req, (const char *)f.start, len);
    return ESP_OK;
}

/* ════════════════════════════════════════════
 *  Static file handler
 * ════════════════════════════════════════════ */

static esp_err_t handler_get_static(httpd_req_t *req) {
    for (auto &f : s_files) {
        if (strcmp(req->uri, f.uri) == 0) {
            return serve_file(req, f);
        }
    }
    // Fallback: serve index.html (SPA routing)
    return serve_file(req, s_files[0]);
}

/* ════════════════════════════════════════════
 *  GET /api/config
 * ════════════════════════════════════════════ */

static esp_err_t handler_get_config(httpd_req_t *req) {
    InductionConfig cfg;
    mcpwm_get_config(cfg);

    cJSON *root = cJSON_CreateObject();
    cJSON_AddBoolToObject(root, "enable",         cfg.enable);
    cJSON_AddNumberToObject(root, "frequency",     cfg.frequency_hz / 1000.0);  // send as kHz
    cJSON_AddNumberToObject(root, "duty",          cfg.duty_percent);
    cJSON_AddNumberToObject(root, "dead_time_red", (double)cfg.dead_time_red_ns);
    cJSON_AddNumberToObject(root, "dead_time_fed", (double)cfg.dead_time_fed_ns);

    char *json = cJSON_PrintUnformatted(root);
    httpd_resp_set_type(req, "application/json");
    httpd_resp_sendstr(req, json);

    cJSON_free(json);
    cJSON_Delete(root);
    return ESP_OK;
}

/* ════════════════════════════════════════════
 *  POST /api/config
 * ════════════════════════════════════════════ */

static esp_err_t handler_post_config(httpd_req_t *req) {
    // Read body
    char buf[256];
    int ret = httpd_req_recv(req, buf, sizeof(buf) - 1);
    if (ret <= 0) {
        httpd_resp_send_err(req, HTTPD_400_BAD_REQUEST, "Empty body");
        return ESP_FAIL;
    }
    buf[ret] = '\0';

    cJSON *root = cJSON_Parse(buf);
    if (!root) {
        httpd_resp_send_err(req, HTTPD_400_BAD_REQUEST, "Invalid JSON");
        return ESP_FAIL;
    }

    InductionConfig cfg;
    mcpwm_get_config(cfg);

    // Parse each field if present
    cJSON *item;

    item = cJSON_GetObjectItem(root, "enable");
    if (cJSON_IsBool(item)) cfg.enable = item->valueint;

    item = cJSON_GetObjectItem(root, "frequency");
    if (cJSON_IsNumber(item)) {
        float freq_khz = (float)item->valuedouble;
        cfg.frequency_hz = (uint32_t)(freq_khz * 1000);
        if (cfg.frequency_hz < PWM_FREQ_MIN) cfg.frequency_hz = PWM_FREQ_MIN;
        if (cfg.frequency_hz > PWM_FREQ_MAX) cfg.frequency_hz = PWM_FREQ_MAX;
    }

    item = cJSON_GetObjectItem(root, "duty");
    if (cJSON_IsNumber(item)) {
        cfg.duty_percent = (float)item->valuedouble;
        if (cfg.duty_percent < PWM_DUTY_MIN) cfg.duty_percent = PWM_DUTY_MIN;
        if (cfg.duty_percent > PWM_DUTY_MAX) cfg.duty_percent = PWM_DUTY_MAX;
    }

    item = cJSON_GetObjectItem(root, "dead_time_red");
    if (cJSON_IsNumber(item)) {
        cfg.dead_time_red_ns = (uint32_t)item->valuedouble;
        if (cfg.dead_time_red_ns > DEADTIME_MAX) cfg.dead_time_red_ns = DEADTIME_MAX;
    }

    item = cJSON_GetObjectItem(root, "dead_time_fed");
    if (cJSON_IsNumber(item)) {
        cfg.dead_time_fed_ns = (uint32_t)item->valuedouble;
        if (cfg.dead_time_fed_ns > DEADTIME_MAX) cfg.dead_time_fed_ns = DEADTIME_MAX;
    }

    cJSON_Delete(root);

    esp_err_t err = mcpwm_apply_config(cfg);
    if (err != ESP_OK) {
        httpd_resp_send_err(req, HTTPD_500_INTERNAL_SERVER_ERROR, "Failed to apply config");
        return ESP_FAIL;
    }

    // Return the applied config as confirmation
    return handler_get_config(req);
}

/* ════════════════════════════════════════════
 *  GET /api/status
 * ════════════════════════════════════════════ */

static esp_err_t handler_get_status(httpd_req_t *req) {
    InductionConfig cfg;
    mcpwm_get_config(cfg);

    InductionFeedback fb;
    mcpwm_get_feedback(fb);

    cJSON *root = cJSON_CreateObject();
    cJSON_AddBoolToObject(root,    "enable",      cfg.enable);
    cJSON_AddNumberToObject(root,  "power",       fb.power_kw);
    cJSON_AddNumberToObject(root,  "voltage",     fb.voltage);
    cJSON_AddNumberToObject(root,  "current",     fb.current_a);
    cJSON_AddNumberToObject(root,  "temperature", fb.temperature_c);
    cJSON_AddBoolToObject(root,    "connected",   wifi_is_connected());
    cJSON_AddStringToObject(root,  "wifi_mode",   wifi_get_mode_str());
    cJSON_AddStringToObject(root,  "wifi_ip",     wifi_get_ip_str());
    cJSON_AddNumberToObject(root,  "uptime_sec",  (double)(esp_timer_get_time() / 1000000));

    char *json = cJSON_PrintUnformatted(root);
    httpd_resp_set_type(req, "application/json");
    httpd_resp_sendstr(req, json);

    cJSON_free(json);
    cJSON_Delete(root);
    return ESP_OK;
}

/* ════════════════════════════════════════════
 *  POST /api/estop
 * ════════════════════════════════════════════ */

static esp_err_t handler_post_estop(httpd_req_t *req) {
    ESP_LOGW(TAG, "*** EMERGENCY STOP via HTTP ***");
    mcpwm_emergency_stop();

    cJSON *root = cJSON_CreateObject();
    cJSON_AddStringToObject(root, "status", "ESTOPPED");
    char *json = cJSON_PrintUnformatted(root);
    httpd_resp_set_type(req, "application/json");
    httpd_resp_sendstr(req, json);
    cJSON_free(json);
    cJSON_Delete(root);
    return ESP_OK;
}

/* ════════════════════════════════════════════
 *  CORS & common headers
 * ════════════════════════════════════════════ */

static esp_err_t common_headers(httpd_req_t *req) {
    httpd_resp_set_hdr(req, "Access-Control-Allow-Origin", "*");
    httpd_resp_set_hdr(req, "Access-Control-Allow-Methods", "GET, POST, OPTIONS");
    httpd_resp_set_hdr(req, "Access-Control-Allow-Headers", "Content-Type");
    return ESP_OK;
}

static esp_err_t handler_options(httpd_req_t *req) {
    common_headers(req);
    httpd_resp_set_status(req, "204 No Content");
    httpd_resp_send(req, NULL, 0);
    return ESP_OK;
}

/* ════════════════════════════════════════════
 *  URI registration
 * ════════════════════════════════════════════ */

static const httpd_uri_t s_routes[] = {
    { .uri = "/",           .method = HTTP_GET,    .handler = handler_get_static,  .user_ctx = nullptr },
    { .uri = "/index.html", .method = HTTP_GET,    .handler = handler_get_static,  .user_ctx = nullptr },
    { .uri = "/style.css",  .method = HTTP_GET,    .handler = handler_get_static,  .user_ctx = nullptr },
    { .uri = "/script.js",  .method = HTTP_GET,    .handler = handler_get_static,  .user_ctx = nullptr },

    { .uri = "/api/config", .method = HTTP_GET,    .handler = handler_get_config,  .user_ctx = nullptr },
    { .uri = "/api/config", .method = HTTP_POST,   .handler = handler_post_config, .user_ctx = nullptr },
    { .uri = "/api/config", .method = HTTP_OPTIONS,.handler = handler_options,     .user_ctx = nullptr },

    { .uri = "/api/status", .method = HTTP_GET,    .handler = handler_get_status,  .user_ctx = nullptr },
    { .uri = "/api/status", .method = HTTP_OPTIONS,.handler = handler_options,     .user_ctx = nullptr },

    { .uri = "/api/estop",  .method = HTTP_POST,   .handler = handler_post_estop,  .user_ctx = nullptr },
    { .uri = "/api/estop",  .method = HTTP_OPTIONS,.handler = handler_options,     .user_ctx = nullptr },
};

/* ════════════════════════════════════════════
 *  Init / Deinit
 * ════════════════════════════════════════════ */

esp_err_t web_server_init(void) {
    httpd_config_t cfg = HTTPD_DEFAULT_CONFIG();
    cfg.max_uri_handlers = 16;
    cfg.stack_size = 4096;

    esp_err_t err = httpd_start(&s_server, &cfg);
    if (err != ESP_OK) {
        ESP_LOGE(TAG, "Failed to start HTTP server: %s", esp_err_to_name(err));
        return err;
    }

    for (auto &route : s_routes) {
        httpd_register_uri_handler(s_server, &route);
    }

    ESP_LOGI(TAG, "HTTP server started on port %u", cfg.server_port);
    return ESP_OK;
}

esp_err_t web_server_stop(void) {
    if (s_server) {
        httpd_stop(s_server);
        s_server = nullptr;
    }
    return ESP_OK;
}
